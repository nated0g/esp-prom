## components/esp-prom-httpd/Kconfig.projbuild
```kconfig
menu "esp-prom configuration"
  config PROM_DEFAULT_METRICS
    bool "Enable default metrics"
  help
    Exposes some helpful metrics like heap memory usage
  default y
endmenu
```
